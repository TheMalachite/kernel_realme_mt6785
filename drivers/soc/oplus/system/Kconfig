## drivers/soc/oplus/system/Kconfig
```kconfig
# SPDX-License-Identifier: GPL-2.0-only
# Copyright (C) 2018-2020 Oplus. All rights reserved.
config OPLUS_SYSTEM_KERNEL
  bool "config oplus system feature "
  default y
  help
	define this config to add oplus sytstem kernel feature

config OPPO_ARCH_FILE
  bool "for build directory oppo"
  ---help---
  say Y to buid in

config OPPO_COMMON_SOFT
  bool "config oppo common software"
  select OPPO_ARCH_FILE
  help
	define this config to get project verion from sharemem.
	Maybe this value is from CDT or dynamic identify by hardware
	id.

config OPPO_DEVICE_IFNO
  tristate "config oppo devinfo"
  select OPPO_ARCH_FILE
  help
	define this config to compile devinfo.c for device register

source "drivers/soc/oplus/system/shutdown_detect/Kconfig"
source "drivers/soc/oplus/system/oplus_project/Kconfig"
source "drivers/soc/oplus/system/hung_task_enhance/Kconfig"
source "drivers/soc/oplus/system/oppo_phoenix/Kconfig"
source "drivers/soc/oplus/system/project_info/Kconfig"

#ifdef OPLUS_FEATURE_ACM
#Yuwei.Guan@BSP.Kernel.FS,2020/07/08, Add for acm
source "drivers/soc/oplus/system/acm/Kconfig"
#endif /* OPLUS_FEATURE_ACM */

#ifdef OPLUS_FEATURE_SELINUX_CONTROL_LOG
#Shuangquan.Du@ANDROID.SELINUX, 2018/01/13, Add for disable selinux denied logs in MP version
source "drivers/soc/oplus/system/selinux/Kconfig"
#endif /* OPLUS_FEATURE_SELINUX_CONTROL_LOG */
```

## drivers/soc/oppo/Kconfig
```kconfig
#ifdef OPLUS_FEATURE_TP_BASIC
# Bin.Li@EXP.BSP.bootloader.bootflow, 2017/05/15, Add for config oppo software common soft
config OPPO_ARCH_FILE
    bool "for build directory oppo"
    ---help---
    say Y to buid in
source "drivers/soc/oppo/oppo_devinfo/Kconfig"

#ifdef OPLUS_FEATURE_NFC_CONSOFT
#/* WangYukun@CONNECTIVITY.NFC.BASIC, 2020/03/24, Add for oppo nfc chipset */
source "drivers/soc/oppo/oppo_nfc/Kconfig"
#endif /* OPLUS_FEATURE_NFC_CONSOFT */

#ifdef OPLUS_FEATURE_SENSOR_SMEM
source "drivers/soc/oppo/oppo_als_cali_value/Kconfig"
#endif /*OPLUS_FEATURE_SENSOR_SMEM */

#ifdef VENDOR_EDIT
#/* WuWeiZhong@BSP.Power.Basic, 2020/06/12, add for wakelock profiler*/
source "drivers/soc/oppo/oppo_wakelock_profiler/Kconfig"
#endif /* VENDOR_EDIT */
```
